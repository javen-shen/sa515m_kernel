## kernel/msm-4.14/drivers/quectel-drivers/Kconfig
```kconfig
#
# Optional quectel drivers configuration
#

menu "Quectel optional drivers"

config QUECTEL_DRIVER
	bool "quectel drivers"
	default y
	---help---
	  Quectel Drivers.

if QUECTEL_DRIVER

config QL_LPM
	tristate "quectel lpm driver(Recommend)"
	default m
	---help---
	  Quectel lpm driver, refer to document.

config QL_SECURITY
	tristate "quectel security features"
	default y
	---help---
	  quectel security features, consult quectel engineer further.

config QL_TZONE
	tristate "quectel trust zone support"
	depends on QL_SECURITY
	default y
	---help---
	  Trust zone function, consult quectel engineer further.

config QABSYSTEM
	bool "QABSYSTEM"
	default y
	---help---
	  quectel AB system

config QSTART
	bool "QSTART"
	default y
	---help---
	  legacy

endif

endmenu
```
